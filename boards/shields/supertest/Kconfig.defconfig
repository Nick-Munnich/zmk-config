## boards/shields/supertest/Kconfig.defconfig
```kconfig
if SHIELD_SUPERTEST

config ZMK_KEYBOARD_NAME
    default "Supermini-Tester"

endif
```

## config/west.yml
```yaml
manifest:
  defaults:
    revision: main
  projects:
    - name: zmk-module-collection
      remote: me
      path: collection
      import:
         file: west.yml
         path-prefix: external-zmk-modules
         name-allowlist: 
             - zmk-keyboards-akohekohe  
    - name: zmk
      remote: zmkfirmware
      import: app/west.yml
  remotes:
    - name: zmkfirmware
      url-base: https://github.com/zmkfirmware
    - name: me
      url-base: https://github.com/Nick-Munnich
  self:
    path: config
```
